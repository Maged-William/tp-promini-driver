## Kconfig
```kconfig
config TRACKPOINT_I2C
    bool "I2C TrackPoint driver"
    default y
    depends on I2C
    help
      Driver for reading TrackPoint X/Y data via I2C from a Pro Mini
      configured as an I2C slave.

config TRACKPOINT_SPI
    bool "SPI TrackPoint driver"
    default y
    select SPI
    depends on INPUT
    depends on DT_HAS_TRACKPOINT_SPI_ENABLED
    help
      Driver for reading TrackPoint X/Y data via SPI from a Pro Mini
      configured as an SPI slave.
```

## boards/shields/spi_test/Kconfig.defconfig
```kconfig
if SHIELD_SPI_TEST

config ZMK_KEYBOARD_NAME
    default "SPI TP Test"

config ZMK_POINTING
    default y

config INPUT
    default y

config SPI
    default y

endif
```

## boards/shields/trackpoint_test/Kconfig.defconfig
```kconfig
if SHIELD_TRACKPOINT_TEST

config ZMK_KEYBOARD_NAME
    default "TP Test"

config ZMK_POINTING
    default y

config INPUT
    default y

config I2C
    default y

config LOG
    default y

config INPUT_LOG_LEVEL
    default 4

endif
```

## boards/shields/trackpoint_test/Kconfig.shield
```kconfig
config SHIELD_TRACKPOINT_TEST
    def_bool $(shields_list_contains,trackpoint_test)
```

## dts/bindings/input/trackpoint,i2c.yaml
```yaml
description: TrackPoint over I2C from Pro Mini slave

compatible: "trackpoint,i2c"

include: i2c-device.yaml

properties:
  dr-gpios:
    type: phandle-array
    required: true
    description:
      Data-ready GPIO pin (active low). Connected to Pro Mini pin 9.
```

## dts/bindings/input/trackpoint,spi.yaml
```yaml
description: TrackPoint over SPI from Pro Mini slave

compatible: "trackpoint,spi"

include: spi-device.yaml

properties:
  report-rate-ms:
    type: int
    default: 10
    description: Polling interval in milliseconds

  swap-xy:
    type: boolean
    description: Swap X and Y axes

  invert-x:
    type: boolean
    description: Invert X axis direction

  invert-y:
    type: boolean
    description: Invert Y axis direction
```
